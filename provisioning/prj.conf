## CMakeLists.txt
```
#
# Copyright (c) 2024 Nordic Semiconductor ASA
#
# SPDX-License-Identifier: LicenseRef-Nordic-5-Clause
#

cmake_minimum_required(VERSION 3.20.0)

find_package(Zephyr REQUIRED HINTS $ENV{ZEPHYR_BASE})
project(softap_wifi_provision_sample)

target_include_directories(app PUBLIC ${ZEPHYR_BASE}/subsys/net/ip)

zephyr_linker_sources(SECTIONS sections-rom.ld)
zephyr_linker_section_ifdef(CONFIG_NET_SAMPLE_HTTP_SERVICE NAME
				http_resource_desc_test_http_service
				KVMA RAM_REGION GROUP RODATA_REGION
				SUBALIGN Z_LINK_ITERABLE_SUBALIGN)

set(gen_dir ${ZEPHYR_BINARY_DIR}/include/generated/)
set(source_file_index src/index.html)
generate_inc_file_for_target(app ${source_file_index} ${gen_dir}/index.html.gz.inc --gzip)
# Needed for net_private.h
# target_include_directories(app PUBLIC ${ZEPHYR_BASE}/subsys/net/ip)

target_sources(app PRIVATE src/main.c)
```

## prj.conf
```kconfig
#
# Copyright (c) 2024 Nordic Semiconductor ASA
#
# SPDX-License-Identifier: LicenseRef-Nordic-5-Clause
#

# Optimize TF-M
CONFIG_TFM_PROFILE_TYPE_SMALL=y
CONFIG_PM_PARTITION_SIZE_TFM_SRAM=0xa000
CONFIG_PM_PARTITION_SIZE_TFM=0x20000

# Optimize Wi-Fi stack to save some memory.
CONFIG_HEAP_MEM_POOL_SIZE=120000
CONFIG_HEAP_MEM_POOL_IGNORE_MIN=y
CONFIG_NRF70_RX_NUM_BUFS=16
CONFIG_NRF70_MAX_TX_AGGREGATION=4

# Wi-Fi
CONFIG_WIFI=y
CONFIG_WIFI_NRF70=y
CONFIG_NRF70_AP_MODE=y
CONFIG_WIFI_NM_WPA_SUPPLICANT=y
CONFIG_WIFI_NM_WPA_SUPPLICANT_AP=y
CONFIG_NET_L2_ETHERNET=y
CONFIG_WIFI_CREDENTIALS=y

# General
CONFIG_LOG=y
CONFIG_LOG_MODE_IMMEDIATE=y
CONFIG_ASSERT=y
CONFIG_ASSERT_VERBOSE=n
CONFIG_REBOOT=y

CONFIG_NET_LOG=y
CONFIG_LOG_DEFAULT_LEVEL=3


# Link-time optimizations
CONFIG_LTO=y
CONFIG_ISR_TABLES_LOCAL_DECLARATION=y

# Temporarily enable FS support so that linking succeeds.
CONFIG_FILE_SYSTEM=y
CONFIG_MAIN_STACK_SIZE=6144
CONFIG_NANOPB=y
CONFIG_SMF=y

# HTTP parser
CONFIG_HTTP_PARSER=y
CONFIG_HTTP_PARSER_URL=y

# DK Butons and LEDs
CONFIG_DK_LIBRARY=y

# Networking config
CONFIG_NETWORKING=y
CONFIG_NET_CONNECTION_MANAGER=y
CONFIG_NET_IPV4=y
# Disable IPv6 to save memory
CONFIG_NET_IPV6=n
CONFIG_NET_TCP=y
CONFIG_NET_UDP=y
CONFIG_NET_SOCKETS=y
CONFIG_NET_MAX_CONN=20
CONFIG_ZVFS_OPEN_MAX=20
CONFIG_NET_SOCKETS_TLS_MAX_CONTEXTS=2
CONFIG_NET_SOCKETS_SOCKOPT_TLS=y

# Zephyr NET Connection Manager connectivity layer
CONFIG_L2_WIFI_CONNECTIVITY=y
CONFIG_L2_WIFI_CONNECTIVITY_AUTO_CONNECT=n
CONFIG_L2_WIFI_CONNECTIVITY_AUTO_DOWN=n

# SoftAP Wi-Fi Provision library
CONFIG_SOFTAP_WIFI_PROVISION=y
CONFIG_SOFTAP_WIFI_PROVISION_THREAD_STACK_SIZE=8192
# Disable socket close on completed provisioning to keep mDNS SD running.
# SD depends on the socket being open for a specified port.
CONFIG_SOFTAP_WIFI_PROVISION_SOCKET_CLOSE_ON_COMPLETION=n
CONFIG_SOFTAP_WIFI_PROVISION_LOG_LEVEL_DBG=y

# (M)DNS
CONFIG_MDNS_RESPONDER=y
CONFIG_DNS_SD=y
CONFIG_MDNS_RESPONDER_DNS_SD=y
CONFIG_NET_HOSTNAME_ENABLE=y
CONFIG_NET_HOSTNAME="wifiprov"
# Disable POSIX uname support to suppress build warning that hostname is too long.
CONFIG_POSIX_UNAME=n

# DHCPv4 client and server
CONFIG_NET_DHCPV4=y
CONFIG_NET_DHCPV4_SERVER=y

# Store TLS credentials to protected storage.
CONFIG_TLS_CREDENTIALS=y
CONFIG_TLS_CREDENTIALS_BACKEND_PROTECTED_STORAGE=y

# Disable auto init of NET config as the softAP Wi-Fi provision library will manually set its
# own IP configuration.
CONFIG_NET_CONFIG_AUTO_INIT=n


CONFIG_FLASH=y
CONFIG_FLASH_MAP=y
CONFIG_NVS=y
CONFIG_SETTINGS=y
CONFIG_SETTINGS_NVS=y


CONFIG_NET_HTTP_LOG_LEVEL_DBG=y
CONFIG_NET_HTTP_SERVER_LOG_LEVEL_DBG=y
CONFIG_HTTP_PARSER_URL=y
CONFIG_HTTP_PARSER=y
CONFIG_HTTP_SERVER=y
```

## boards/thingy91x_nrf5340_cpuapp.conf
```kconfig
CONFIG_SPI=y
CONFIG_FLASH=y
CONFIG_SPI_NOR=y
CONFIG_SPI_NOR_FLASH_LAYOUT_PAGE_SIZE=4096
CONFIG_SPI_NOR_SFDP_DEVICETREE=y
CONFIG_I2C=y

CONFIG_NFCT_PINS_AS_GPIOS=y


# USB
CONFIG_USB_DEVICE_STACK=y
CONFIG_USB_DEVICE_PRODUCT="Thingy:91x USB Logging"
CONFIG_USB_CDC_ACM=y
CONFIG_USB_COMPOSITE_DEVICE=y
CONFIG_USB_MASS_STORAGE=n
CONFIG_USB_DEVICE_MANUFACTURER="Nordic Semiconductor"
CONFIG_USB_DEVICE_VID=0x1915
CONFIG_USB_DEVICE_PID=0x910A

CONFIG_USB_DEVICE_REMOTE_WAKEUP=n
CONFIG_USB_DEVICE_INITIALIZE_AT_BOOT=y

CONFIG_USE_SEGGER_RTT=n
CONFIG_RTT_CONSOLE=n

CONFIG_FW_INFO=y
CONFIG_SECURE_BOOT_STORAGE=y
```

## src/main.c
```c
/*
 * Copyright (c) 2024 Nordic Semiconductor ASA
 *
 * SPDX-License-Identifier: LicenseRef-Nordic-5-Clause
 */

#include <stdio.h>
#include <errno.h>
#include <zephyr/kernel.h>
#include <zephyr/logging/log.h>
#include <zephyr/logging/log_ctrl.h>
#include <zephyr/sys/reboot.h>
#include <zephyr/net/wifi_mgmt.h>
#include <zephyr/net/net_mgmt.h>
#include <zephyr/net/net_event.h>
#include <zephyr/net/conn_mgr_monitor.h>
#include <zephyr/net/conn_mgr_connectivity.h>
#include <zephyr/net/dhcpv4.h>
#include <dk_buttons_and_leds.h>
#include <net/softap_wifi_provision.h>

#include <zephyr/net/http/server.h>
#include <zephyr/net/http/service.h>

#include <net/wifi_credentials.h>

LOG_MODULE_REGISTER(softap_wifi_provision_sample, LOG_LEVEL_DBG);

/* Macro used to subscribe to specific Zephyr NET management events. */
#define L4_EVENT_MASK (NET_EVENT_L4_CONNECTED | NET_EVENT_L4_DISCONNECTED)
#define CONN_LAYER_EVENT_MASK (NET_EVENT_CONN_IF_FATAL_ERROR)

/* Macro called upon a fatal error, reboots the device. */
#define FATAL_ERROR()								\
	LOG_ERR("Fatal error!%s", IS_ENABLED(CONFIG_RESET_ON_FATAL_ERROR) ?	\
				  " Rebooting the device" : "");		\
	LOG_PANIC();								\
	IF_ENABLED(CONFIG_REBOOT, (sys_reboot(0)))

/* Callbacks for Zephyr NET management events. */
static struct net_mgmt_event_callback l4_cb;
static struct net_mgmt_event_callback conn_cb;

///////////////////////////////////////////////////////////////////////////////
// HTTP data

static uint16_t	test_http_service_port = 80;
HTTP_SERVICE_DEFINE(test_http_service, NULL, &test_http_service_port, 1,
		    10, NULL);

static const uint8_t index_html_gz[] = {
    #include "index.html.gz.inc"
};

struct http_resource_detail_static index_html_gz_resource_detail = {
    .common = {
        .type = HTTP_RESOURCE_TYPE_STATIC,
        .bitmask_of_supported_http_methods = BIT(HTTP_GET),
        .content_encoding = "gzip",
		.content_type = "text/html",
    },
    .static_data = index_html_gz,
    .static_data_len = sizeof(index_html_gz),
};

HTTP_RESOURCE_DEFINE(index_html_gz_resource, test_http_service, "/",
		     &index_html_gz_resource_detail);

///////////////////////////////////////////////////////////////////////////////

static void l4_event_handler(struct net_mgmt_event_callback *cb,
			     uint32_t event,
			     struct net_if *iface)
{
	switch (event) {
	case NET_EVENT_L4_CONNECTED:
		LOG_INF("Network connected");

		int ret = dk_set_led_on(DK_LED2);

		if (ret) {
			LOG_ERR("dk_set_led_on, error: %d", ret);
			FATAL_ERROR();
			return;
		}

		/* Start the DHCPv4 client after the device is provisioned to a network.
		 * This is needed to get a dynamic IPv4 address from the APs DHCPv4 server.
		 */
		net_dhcpv4_start(iface);
		break;
	case NET_EVENT_L4_DISCONNECTED:
		LOG_INF("Network disconnected");
		break;
	default:
		/* Don't care */
		return;
	}
}

static void connectivity_event_handler(struct net_mgmt_event_callback *cb,
				       uint32_t event,
				       struct net_if *iface)
{
	if (event == NET_EVENT_CONN_IF_FATAL_ERROR) {
		LOG_ERR("NET_EVENT_CONN_IF_FATAL_ERROR");
		FATAL_ERROR();
		return;
	}
}

/* Callback for softAP Wi-Fi provision library events. */
static void softap_wifi_provision_handler(const struct softap_wifi_provision_evt *evt)
{
	int ret;

	switch (evt->type) {
	case SOFTAP_WIFI_PROVISION_EVT_STARTED:
		LOG_INF("Provisioning started");

		ret = dk_set_led_on(DK_LED1);
		if (ret) {
			LOG_ERR("dk_set_led_on, error: %d", ret);
			FATAL_ERROR();
			return;
		}

		break;
	case SOFTAP_WIFI_PROVISION_EVT_CLIENT_CONNECTED:
		LOG_INF("Client connected");
		break;
	case SOFTAP_WIFI_PROVISION_EVT_CLIENT_DISCONNECTED:
		LOG_INF("Client disconnected");
		break;
	case SOFTAP_WIFI_PROVISION_EVT_CREDENTIALS_RECEIVED:
		LOG_INF("Wi-Fi credentials received");
		break;
	case SOFTAP_WIFI_PROVISION_EVT_COMPLETED:
		LOG_INF("Provisioning completed");
		break;
	case SOFTAP_WIFI_PROVISION_EVT_UNPROVISIONED_REBOOT_NEEDED:
		LOG_INF("Reboot request notified, rebooting...");

		LOG_PANIC();
		IF_ENABLED(CONFIG_REBOOT, (sys_reboot(0)));
		break;
	case SOFTAP_WIFI_PROVISION_EVT_FATAL_ERROR:
		LOG_ERR("Provisioning failed, fatal error!");
		FATAL_ERROR();
		break;
	default:
		/* Don't care */
		return;
	}
}

static void button_handler(uint32_t button_states, uint32_t has_changed)
{
	if ((has_changed & DK_BTN1_MSK) && (button_states & DK_BTN1_MSK)) {
		LOG_INF("Button 1 pressed");

		int ret = softap_wifi_provision_reset();

		if (ret) {
			LOG_ERR("softap_wifi_provision_reset, error: %d", ret);
			FATAL_ERROR();
			return;
		}
	}
}

static int wifi_power_saving_disable(void)
{
	int ret;
	struct net_if *iface = net_if_get_first_wifi();
		struct wifi_ps_params params = {
		.enabled = WIFI_PS_DISABLED
	};

	ret = net_mgmt(NET_REQUEST_WIFI_PS, iface, &params, sizeof(params));
	if (ret) {
		LOG_ERR("Failed to disable PSM, error: %d", ret);
		FATAL_ERROR();
		return ret;
	}

	return 0;
}

static int wifi_power_saving_enable(void)
{
	int ret;
	struct net_if *iface = net_if_get_first_wifi();
	struct wifi_ps_params params = {
		.enabled = WIFI_PS_ENABLED
	};

	ret = net_mgmt(NET_REQUEST_WIFI_PS, iface, &params, sizeof(params));
	if (ret) {
		LOG_ERR("Failed to enable PSM, error: %d", ret);
		FATAL_ERROR();
		return ret;
	}

	return 0;
}

/* Function used to disable and re-enable PSM after a configured amount of time post provisioning.
 * This is to ensure that the device is discoverable via mDNS so that clients can
 * confirm that provisioning succeeded. This is needed due to mDNS SD being unstable
 * in Power Save Mode.
 */
static void psm_set(void)
{
	int ret;

	ret = wifi_power_saving_disable();
	if (ret) {
		LOG_ERR("wifi_power_saving_disable, error: %d", ret);
		FATAL_ERROR();
		return;
	}

	LOG_INF("PSM disabled");

	k_sleep(K_SECONDS(CONFIG_SOFTAP_WIFI_PROVISION_SAMPLE_PSM_DISABLED_SECONDS));

	ret = wifi_power_saving_enable();
	if (ret) {
		LOG_ERR("wifi_power_saving_enable, error: %d", ret);
		FATAL_ERROR();
		return;
	}

	LOG_INF("PSM enabled");
}

int main(void)
{
	int ret;
	bool provisioning_completed = false;

	LOG_INF("SoftAP Wi-Fi provision sample started");

	ret = dk_buttons_init(button_handler);
	if (ret) {
		LOG_ERR("dk_buttons_init, error: %d", ret);
		FATAL_ERROR();
		return ret;
	}

	ret = dk_leds_init();
	if (ret) {
		LOG_ERR("dk_leds_init, error: %d", ret);
		FATAL_ERROR();
		return ret;
	}

	ret = softap_wifi_provision_init(softap_wifi_provision_handler);
	if (ret) {
		LOG_ERR("softap_wifi_provision_init, error: %d", ret);
		FATAL_ERROR();
		return ret;
	}

	ret = conn_mgr_all_if_up(true);
	if (ret) {
		LOG_ERR("conn_mgr_all_if_up, error: %d", ret);
		FATAL_ERROR();
		return ret;
	}

	LOG_INF("Network interface brought up");

	ret = softap_wifi_provision_start();
	switch (ret) {
	case 0:
		provisioning_completed = true;
		break;
	case -EALREADY:
		LOG_INF("Wi-Fi credentials found, skipping provisioning");
		break;
	default:
		LOG_ERR("softap_wifi_provision_start, error: %d", ret);
		FATAL_ERROR();
		return ret;
	}

	/* Register NET mgmt handlers for Connection Manager events after provisioning
	 * is completed. This is to avoid receiving events during provisioning when the device is
	 * in softAP (server) mode and gets assigned an IP,
	 * which triggers the NET_EVENT_L4_CONNECTED.
	 */

	/* Setup handler for Zephyr NET Connection Manager events. */
	net_mgmt_init_event_callback(&l4_cb, l4_event_handler, L4_EVENT_MASK);
	net_mgmt_add_event_callback(&l4_cb);

	/* Setup handler for Zephyr NET Connection Manager Connectivity layer. */
	net_mgmt_init_event_callback(&conn_cb, connectivity_event_handler, CONN_LAYER_EVENT_MASK);
	net_mgmt_add_event_callback(&conn_cb);

	ret = conn_mgr_all_if_connect(true);
	if (ret) {
		LOG_ERR("conn_mgr_all_if_connect, error: %d", ret);
		FATAL_ERROR();
		return ret;
	}

	if (provisioning_completed) {
		psm_set();
        LOG_WRN("HTTP server staring");
        http_server_start();
	}

	return 0;
}
```
